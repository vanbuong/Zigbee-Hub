## components/zb_button/Kconfig
```kconfig
menu "Zigbee Button (FR-10)"

    config ZB_BUTTON_GPIO
        int "Button GPIO number"
        default 34
        range 0 48
        help
            ESP32 GPIO connected to the momentary push-button.
            GPIO34 is an input-only pin on ESP32; an external pull-up to 3.3 V
            is required on the PCB.

    config ZB_BUTTON_ACTIVE_LOW
        bool "Button active-low (pressed = LOW)"
        default y
        help
            Set y when the button shorts the GPIO to GND when pressed (external
            pull-up present).  Set n for active-high with an external pull-down.

    config ZB_BUTTON_DEBOUNCE_MS
        int "Debounce stable window (ms)"
        default 20
        range 5 100
        help
            The GPIO level must be stable for this many milliseconds before
            a press or release is accepted (FR-10.2).

    config ZB_BUTTON_LONG_PRESS_MS
        int "Long-press threshold (ms)"
        default 1500
        range 500 10000
        help
            Hold time that triggers a ZB_BTN_LONG event, emitted once while
            the button is still held (FR-10.3).

    config ZB_BUTTON_MULTI_PRESS_TIMEOUT_MS
        int "Multi-press inter-press timeout (ms)"
        default 400
        range 100 1000
        help
            Maximum gap between consecutive presses in a multi-press gesture.
            A ZB_BTN_SINGLE event is emitted when this timeout expires after
            the first press without a second press (FR-10.3).

    config ZB_BUTTON_POLL_INTERVAL_MS
        int "Button polling interval (ms)"
        default 10
        range 5 50
        help
            Period of the button task polling loop (FR-10.8).

    config ZB_BUTTON_PERMIT_JOIN_SECONDS
        int "Permit-join duration on single press (seconds)"
        default 60
        range 0 254
        help
            Duration passed to zb_cmd_permit_join() when a single press is
            detected and the framework is in READY state (FR-10.6).
            0 = close join window, 254 = open indefinitely.

    config ZB_BUTTON_TASK_STACK
        int "Button task stack size (bytes)"
        default 2048
        range 1024 8192

    config ZB_BUTTON_TASK_PRIORITY
        int "Button task FreeRTOS priority"
        default 3
        range 1 24

endmenu
```

## components/zb_cmd/Kconfig
```kconfig
menu "Zigbee Command Queue"

    config ZB_CMD_QUEUE_DEPTH
        int "Command queue depth"
        default 16
        range 4 64
        help
            Number of commands that can be buffered while the framework is
            not in READY state (e.g. during FORMING or RECONFIGURING).

endmenu
```

## components/zb_framework/Kconfig
```kconfig
menu "Zigbee Framework"

    config ZB_DEFAULT_PAN_ID
        hex "Default PAN ID"
        default 0x1A2B
        help
            16-bit Zigbee PAN ID used when none is stored in NVS.
            Override at runtime via zb_config_t.pan_id.

    config ZB_DEFAULT_CHANNEL
        int "Default Zigbee channel"
        default 15
        range 11 26
        help
            Zigbee 2.4 GHz channel used when none is stored in NVS.
            Channel 15 avoids overlap with common Wi-Fi channels.

    config ZB_FRAMEWORK_TASK_STACK
        int "Framework task stack size (bytes)"
        default 8192
        range 4096 32768

    config ZB_FRAMEWORK_TASK_PRIORITY
        int "Framework task FreeRTOS priority"
        default 5
        range 1 24

    config ZB_NOTIFY_TASK_STACK
        int "Notify task stack size (bytes)"
        default 4096
        range 2048 16384
        help
            Stack size for the zb_notify_task that delivers zb_cap_event_t
            callbacks to upper-layer subscribers (FR-5.8).

endmenu
```

## components/zb_storage/Kconfig
```kconfig
menu "Zigbee Storage (LittleFS)"

    config ZB_STORAGE_PARTITION_LABEL
        string "LittleFS partition label"
        default "storage"
        help
            Must match the partition name in partitions.csv.

    config ZB_STORAGE_MOUNT_POINT
        string "VFS mount point"
        default "/zb"
        help
            Base path for all storage files. Config and device files
            are placed relative to this path.

    config ZB_STORAGE_FORMAT_ON_FAIL
        bool "Format partition if mount fails"
        default y
        help
            If the LittleFS partition cannot be mounted (e.g. first boot or
            corruption), format it automatically and continue. Disable in
            production to detect silent data loss.

    config ZB_DEV_PB_MAX_SIZE
        int "Maximum encoded device protobuf size (bytes)"
        default 1024
        range 256 4096
        help
            Buffer size used when encoding or decoding a single ZbDeviceRecord.
            Must be large enough for the maximum number of endpoints, clusters,
            and attributes configured in zb_device.options.

endmenu
```

## components/znp_transport/Kconfig
```kconfig
menu "ZNP Transport"

    config ZNP_UART_PORT
        int "UART port number"
        default 1
        range 0 2
        help
            UART peripheral to use for CC2652P7 ZNP communication.

    config ZNP_UART_BAUD
        int "UART baud rate"
        default 921600
        help
            ZNP UART baud rate. Common values: 115200, 230400, 460800, 921600.

    config ZNP_GPIO_TX
        int "TX GPIO pin"
        default 2
        help
            ESP32 GPIO connected to CC2652P7 RX (ZNP data).

    config ZNP_GPIO_RX
        int "RX GPIO pin"
        default 32
        help
            ESP32 GPIO connected to CC2652P7 TX (ZNP data).

    comment "CC2652P7 RESET / BSL routed through PCA9538 I2C GPIO expander"

    config ZNP_PCA9538_SDA
        int "PCA9538 I2C SDA GPIO pin"
        default 4
        help
            ESP32 GPIO connected to the PCA9538 SDA line.

    config ZNP_PCA9538_SCL
        int "PCA9538 I2C SCL GPIO pin"
        default 33
        help
            ESP32 GPIO connected to the PCA9538 SCL line.

    config ZNP_PCA9538_I2C_PORT
        int "PCA9538 I2C port number"
        default 0
        range 0 1
        help
            ESP32 I2C peripheral used to talk to the PCA9538.

    config ZNP_PCA9538_ADDR
        hex "PCA9538 7-bit I2C address"
        default 0x70
        range 0x70 0x73
        help
            PCA9538 address (0x70..0x73 set by A0/A1 strapping pins).

    config ZNP_PCA9538_RESET_BIT
        int "PCA9538 bit position for CC2652P7 RESET"
        default 0
        range 0 7
        help
            PCA9538 IO bit driving the CC2652P7 RESET pin (active-low).

    config ZNP_PCA9538_BSL_BIT
        int "PCA9538 bit position for CC2652P7 BSL invoke"
        default 1
        range 0 7
        help
            PCA9538 IO bit driving the CC2652P7 BSL_INVOKE pin (active-low).

    config ZNP_PCA9538_RST_GPIO
        int "PCA9538 RESET GPIO pin (-1 = not wired)"
        default 5
        range -1 39
        help
            ESP32 GPIO connected to the PCA9538 RESET pin (active-low).
            Pulsed low briefly at boot to bring the expander into a known
            state before any I2C transactions. Set to -1 if the PCA9538
            RESET pin is tied directly to VCC (no software control).

    config ZNP_SREQ_TIMEOUT_MS
        int "SREQ response timeout (ms)"
        default 1000
        range 500 10000
        help
            How long to wait for an SRSP after sending an SREQ.

    config ZNP_RESET_TIMEOUT_MS
        int "Reset indication timeout (ms)"
        default 6000
        range 1000 10000
        help
            How long to wait for SYS_RESET_IND after asserting the RESET GPIO.

    config ZNP_AREQ_QUEUE_DEPTH
        int "AREQ queue depth (frames)"
        default 32
        range 8 128
        help
            Number of AREQ frames that can be buffered between the dispatch task
            and the framework consumer.

    config ZNP_RX_TASK_STACK
        int "RX task stack size (bytes)"
        default 4096
        range 2048 16384

    config ZNP_DISPATCH_TASK_STACK
        int "Dispatch task stack size (bytes)"
        default 3072
        range 2048 8192

endmenu
```

## sdkconfig.defaults
```kconfig
CONFIG_FREERTOS_HZ=1000
CONFIG_ESP_SYSTEM_EVENT_TASK_STACK_SIZE=4096
CONFIG_LOG_DEFAULT_LEVEL_DEBUG=y
CONFIG_UART_ISR_IN_IRAM=y
CONFIG_NVS_ASSERT_ERROR_CHECK=n
CONFIG_PARTITION_TABLE_CUSTOM=y
CONFIG_PARTITION_TABLE_CUSTOM_FILENAME="partitions.csv"
# LittleFS
CONFIG_LITTLEFS_HUMAN_READABLE=n
CONFIG_LITTLEFS_USE_MTIME=y
```
